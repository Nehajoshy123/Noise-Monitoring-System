#include "oled.h"
#include <string.h>

static I2C_HandleTypeDef *oled_i2c;
static uint8_t OLED_Buffer[512]; // 128x32 / 8 = 512 bytes
static uint8_t cursor_x = 0;
static uint8_t cursor_page = 0;

/* 5x7 ASCII Font Data (32 ' ' to 126 '~') */
static const uint8_t Font5x7[][5] = {
    {0x00, 0x00, 0x00, 0x00, 0x00}, // Space
    {0x00, 0x00, 0x5F, 0x00, 0x00}, // !
    {0x00, 0x07, 0x00, 0x07, 0x00}, // "
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    {0x61, 0x51, 0x49, 0x45, 0x43}  // Z
};

static void OLED_WriteCommand(uint8_t cmd) {
    HAL_I2C_Mem_Write(oled_i2c, OLED_I2C_ADDR, 0x00, 1, &cmd, 1, 100);
}

void OLED_Init(I2C_HandleTypeDef *hi2c) {
    oled_i2c = hi2c;
    HAL_Delay(100);

    /* SSD1306 128x32 Initialization Command Sequence */
    OLED_WriteCommand(0xAE); // Display OFF
    OLED_WriteCommand(0xD5); // Set Display Clock Divide Ratio
    OLED_WriteCommand(0x80);
    OLED_WriteCommand(0xA8); // Set Multiplex Ratio
    OLED_WriteCommand(0x1F); // 31 for 128x32
    OLED_WriteCommand(0xD3); // Set Display Offset
    OLED_WriteCommand(0x00);
    OLED_WriteCommand(0x40); // Set Start Line
    OLED_WriteCommand(0x8D); // Enable Charge Pump
    OLED_WriteCommand(0x14);
    OLED_WriteCommand(0x20); // Memory Addressing Mode (Horizontal)
    OLED_WriteCommand(0x00);
    OLED_WriteCommand(0xA1); // Segment Re-map
    OLED_WriteCommand(0xC8); // COM Output Scan Direction
    OLED_WriteCommand(0xDA); // Set COM Pins Hardware Configuration
    OLED_WriteCommand(0x02);
    OLED_WriteCommand(0x81); // Set Contrast
    OLED_WriteCommand(0x8F);
    OLED_WriteCommand(0xD9); // Set Pre-charge Period
    OLED_WriteCommand(0xF1);
    OLED_WriteCommand(0xDB); // Set VCOMH Deselect Level
    OLED_WriteCommand(0x40);
    OLED_WriteCommand(0xA4); // Entire Display ON
    OLED_WriteCommand(0xA6); // Normal Display
    OLED_WriteCommand(0xAF); // Display ON

    OLED_Clear();
    OLED_Update();
}

void OLED_Clear(void) {
    memset(OLED_Buffer, 0x00, sizeof(OLED_Buffer));
}

void OLED_Update(void) {
    for (uint8_t page = 0; page < 4; page++) {
        OLED_WriteCommand(0xB0 + page);
        OLED_WriteCommand(0x00);
        OLED_WriteCommand(0x10);
        HAL_I2C_Mem_Write(oled_i2c, OLED_I2C_ADDR, 0x40, 1, &OLED_Buffer[page * 128], 128, 100);
    }
}

void OLED_SetCursor(uint8_t x, uint8_t page) {
    if (x < OLED_WIDTH) cursor_x = x;
    if (page < 4) cursor_page = page;
}

void OLED_WriteChar(char c) {
    if (c < ' ' || c > 'Z') c = ' ';
    uint8_t idx = c - ' ';

    for (uint8_t i = 0; i < 5; i++) {
        if (cursor_x < OLED_WIDTH) {
            OLED_Buffer[cursor_page * 128 + cursor_x] = Font5x7[idx][i];
            cursor_x++;
        }
    }
    /* Add 1px space between characters */
    if (cursor_x < OLED_WIDTH) {
        OLED_Buffer[cursor_page * 128 + cursor_x] = 0x00;
        cursor_x++;
    }
}

void OLED_WriteString(const char *str) {
    while (*str) {
        OLED_WriteChar(*str++);
    }
}
